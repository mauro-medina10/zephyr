## drivers/adc/Kconfig.nau7802
```kconfig
# NAU7802 ADC configuration options

# Copyright (c) 2025 https://github.com/mauro-medina10
# SPDX-License-Identifier: Apache-2.0

config ADC_NAU7802
	bool "NAU7802 driver"
	default y
	# depends on DT_HAS_NUVOTON_NAU7802_ENABLED 

	select I2C
	select ADC_CONFIGURABLE_INPUTS
	help
	  Enable NAU7802 ADC driver.

if ADC_NAU7802

config ADC_NAU7802_INIT_PRIORITY
	int "Init priority"
	default 80
	help
	  NAU7802 ADC device driver initialization priority.

config ADC_NAU7802_ACQUISITION_THREAD_PRIO
	int "Priority for the ADC data acquisition thread"
	default 0
	help
	  Priority level for the internal ADC data acquisition thread.

config ADC_NAU7802_ACQUISITION_THREAD_STACK_SIZE
	int "Stack size for the ADC data acquisition thread"
	default 1024
	help
	  Size of the stack used for the internal data acquisition
	  thread.

endif # ADC_NAU7802
```

## dts/bindings/adc/nuvoton,nau7802-adc.yaml
```yaml
# Copyright (c) 2020 Nuvoton Technology Corporation.
# SPDX-License-Identifier: Apache-2.0

description: Nuvoton, NAU7802-ADC node

compatible: "nuvoton,nau7802-adc"

include: [adc-controller.yaml, i2c-device.yaml]

properties:
  "#io-channel-cells":
    const: 1

  alert-rdy-gpios:
    type: phandle-array
    description: Interrupt pin. Conversion ready

io-channel-cells:
  - input
```
